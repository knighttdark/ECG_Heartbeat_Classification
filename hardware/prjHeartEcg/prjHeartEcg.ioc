# file: prjHeartEcg.ioc
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ADC1.Channel-0\#ChannelRegularConversion=ADC_CHANNEL_0
ADC1.NbrOfConversionFlag=1
ADC1.Rank-0\#ChannelRegularConversion=1
ADC1.SamplingTime-0\#ChannelRegularConversion=ADC_SAMPLETIME_144CYCLES
ADC1.master=1
Mcu.Family=STM32F4
Mcu.Name=STM32F407V(E-G)Tx
Mcu.Package=LQFP100
NVIC.PriorityGroup=NVIC_PRIORITYGROUP_4
PA0-WKUP.Signal=ADCx_IN0
PA13.Mode=Serial_Wire
PA13.Signal=SYS_JTMS-SWDIO
PA14.Mode=Serial_Wire
PA14.Signal=SYS_JTCK-SWCLK
ProjectManager.HeapSize=0x200
ProjectManager.StackSize=0x400
ProjectManager.TargetToolchain=STM32CubeIDE
RCC.48MHZClocksFreq_Value=84000000
RCC.AHBFreq_Value=168000000
RCC.APB1CLKDivider=RCC_HCLK_DIV4
RCC.APB1Freq_Value=42000000
RCC.APB1TimFreq_Value=84000000
RCC.APB2CLKDivider=RCC_HCLK_DIV2
RCC.APB2Freq_Value=84000000
RCC.APB2TimFreq_Value=168000000
RCC.CortexFreq_Value=168000000
RCC.HCLKFreq_Value=168000000
RCC.HSE_VALUE=25000000
RCC.HSI_VALUE=16000000
RCC.LSE_VALUE=32768
RCC.PLLM=8
RCC.PLLN=168
RCC.SYSCLKFreq_VALUE=168000000
RCC.SYSCLKSource=RCC_SYSCLKSOURCE_PLLCLK
RCC.VCOOutputFreq_Value=336000000
SH.ADCx_IN0.0=ADC1_IN0,IN0
STMicroelectronics.X-CUBE-AI.10.0.0.ActivationBufferSizeList=43880
STMicroelectronics.X-CUBE-AI.10.0.0.ActivationBuffers=pool0
STMicroelectronics.X-CUBE-AI.10.0.0.ActivationNames=pool0
STMicroelectronics.X-CUBE-AI.10.0.0.ActivationSizes=AI_NETWORK_DATA_ACTIVATION_1_SIZE
STMicroelectronics.X-CUBE-AI.10.0.0.HeapSize=0x800
STMicroelectronics.X-CUBE-AI.10.0.0.InternalRamActivationBufferMaxSize=AI_NETWORK_DATA_ACTIVATIONS_SIZE
STMicroelectronics.X-CUBE-AI.10.0.0.LatestDirectoryUsed-781936a40a988547c058640a9e899acb095386a14b1ffe75995383c3d91156ff=D\:\\ECG_Heartbeat_Classification\\models
STMicroelectronics.X-CUBE-AI.10.0.0.MaximumNumberOfInputLayer=1
STMicroelectronics.X-CUBE-AI.10.0.0.MaximumNumberOfOutputLayer=1
STMicroelectronics.X-CUBE-AI.10.0.0.MaximumSizeOfInputLayer=1
STMicroelectronics.X-CUBE-AI.10.0.0.MaximumSizeOfOutputLayer=1
STMicroelectronics.X-CUBE-AI.10.0.0.ModelActualCompression-781936a40a988547c058640a9e899acb095386a14b1ffe75995383c3d91156ff=0.0
STMicroelectronics.X-CUBE-AI.10.0.0.ModelCompression-781936a40a988547c058640a9e899acb095386a14b1ffe75995383c3d91156ff=None
STMicroelectronics.X-CUBE-AI.10.0.0.ModelFlashOccupation-781936a40a988547c058640a9e899acb095386a14b1ffe75995383c3d91156ff=1038164
STMicroelectronics.X-CUBE-AI.10.0.0.ModelHashList=781936a40a988547c058640a9e899acb095386a14b1ffe75995383c3d91156ff
STMicroelectronics.X-CUBE-AI.10.0.0.ModelKind-781936a40a988547c058640a9e899acb095386a14b1ffe75995383c3d91156ff=TFLITE
STMicroelectronics.X-CUBE-AI.10.0.0.ModelMacc-781936a40a988547c058640a9e899acb095386a14b1ffe75995383c3d91156ff=4299099
STMicroelectronics.X-CUBE-AI.10.0.0.ModelName-781936a40a988547c058640a9e899acb095386a14b1ffe75995383c3d91156ff=network
STMicroelectronics.X-CUBE-AI.10.0.0.ModelNameList=network
STMicroelectronics.X-CUBE-AI.10.0.0.ModelRamOccupation-781936a40a988547c058640a9e899acb095386a14b1ffe75995383c3d91156ff=43880
STMicroelectronics.X-CUBE-AI.10.0.0.ModelStructureFile-781936a40a988547c058640a9e899acb095386a14b1ffe75995383c3d91156ff=D\:\\ECG_Heartbeat_Classification\\models\\train_mitbih_cnn.tflite
STMicroelectronics.X-CUBE-AI.10.0.0.ModelType-781936a40a988547c058640a9e899acb095386a14b1ffe75995383c3d91156ff=STM32Cube.AI MCU runtime
STMicroelectronics.X-CUBE-AI.10.0.0.ReadyForCodeGeneration=true
STMicroelectronics.X-CUBE-AI.10.0.0.StackSize=0x800
STMicroelectronics.X-CUBE-AI.10.0.0.WorkingBufferStartAddrList=0xFFFFFFFF
STMicroelectronics.X-CUBE-AI.10.0.0.XAaCUBEAaAICcArtificialOoIntelligenceJjCore=true
STMicroelectronics.X-CUBE-AI.10.0.0.copyWeightToRam=false
STMicroelectronics.X-CUBE-AI.10.0.0.copyWeightToRam-781936a40a988547c058640a9e899acb095386a14b1ffe75995383c3d91156ff=false
STMicroelectronics.X-CUBE-AI.10.0.0.customLayerConfigEnabled=false
STMicroelectronics.X-CUBE-AI.10.0.0.customLayerConfigEnabled-781936a40a988547c058640a9e899acb095386a14b1ffe75995383c3d91156ff=false
STMicroelectronics.X-CUBE-AI.10.0.0.noOnnxIoTranspose=false
STMicroelectronics.X-CUBE-AI.10.0.0.noOnnxIoTranspose-781936a40a988547c058640a9e899acb095386a14b1ffe75995383c3d91156ff=false
STMicroelectronics.X-CUBE-AI.10.0.0.useInputAllocation=true
STMicroelectronics.X-CUBE-AI.10.0.0.useInputAllocation-781936a40a988547c058640a9e899acb095386a14b1ffe75995383c3d91156ff=true
STMicroelectronics.X-CUBE-AI.10.0.0.useOutputAllocation=true
STMicroelectronics.X-CUBE-AI.10.0.0.useOutputAllocation-781936a40a988547c058640a9e899acb095386a14b1ffe75995383c3d91156ff=true
VP_STMicroelectronics.X-CUBE-AI_VS_ArtificialOoIntelligenceJjXAaCUBEAaAI_10.0.0.Mode=ArtificialOoIntelligenceJjXAaCUBEAaAI
board=custom

// file: Core/Src/main.c
/* USER CODE BEGIN Header */
/**
  ******************************************************************************
  * @file           : main.c
  * @brief          : Main program body
  ******************************************************************************
  * @attention
  *
  * Copyright (c) 2025 STMicroelectronics.
  * All rights reserved.
  *
  * This software is licensed under terms that can be found in the LICENSE file
  * in the root directory of this software component.
  * If no LICENSE file comes with this software, it is provided AS-IS.
  *
  ******************************************************************************
  */
/* USER CODE END Header */
#include "main.h"

/* USER CODE BEGIN Includes */
#include "network.h"
#include "network_data.h"
#include "arm_math.h"
#include "arm_const_structs.h"
/* USER CODE BEGIN PV */

/* USER CODE END PV */
/* USER CODE BEGIN PD */

/* USER CODE END PD */
/* USER CODE END Includes */

/* USER CODE BEGIN PD */
#define FFT_SIZE 64
/* USER CODE END PD */

q15_t inputSignal[FFT_SIZE];
q15_t complexSpectrum[FFT_SIZE*2];
q15_t realSpectrum[FFT_SIZE];

ADC_HandleTypeDef hadc1;

/* USER CODE BEGIN PV */

static ai_handle network = AI_HANDLE_NULL;
AI_ALIGNED(32) static ai_u8 activations[AI_NETWORK_DATA_ACTIVATIONS_SIZE];
AI_ALIGNED(32) static ai_i8 random_input[AI_NETWORK_IN_1_SIZE];
AI_ALIGNED(32) static ai_float out_data[AI_NETWORK_OUT_1_SIZE];
static ai_buffer *ai_input;
static ai_buffer *ai_output;
uint16_t ecg_raw;
/* USER CODE END PV */

void SystemClock_Config(void);
static void MX_GPIO_Init(void);
static void MX_ADC1_Init(void);

/* USER CODE BEGIN 0 */
void AI_Init(void)
{
    const ai_handle acts[] = { activations };
    ai_network_create_and_init(&network, acts, NULL);

    ai_input = ai_network_inputs_get(network, NULL);
    ai_output = ai_network_outputs_get(network, NULL);
}

void AI_Run(const void *in_data, void *out_data)
{
    ai_input[0].data = AI_HANDLE_PTR(in_data);
    ai_output[0].data = AI_HANDLE_PTR(out_data);

    ai_network_run(network, &ai_input[0], &ai_output[0]);
}
/* USER CODE END 0 */

int main(void)
{

  /* MCU Configuration--------------------------------------------------------*/

  /* Reset of all peripherals, Initializes the Flash interface and the Systick. */
  HAL_Init();

  /* Configure the system clock */
  SystemClock_Config();

  /* Initialize all configured peripherals */
  MX_GPIO_Init();
  MX_ADC1_Init();
  /* USER CODE BEGIN 2 */
  //AI_Init();
  uint8_t freqBin=1;
  /* USER CODE END 2 */

  /* Infinite loop */
  /* USER CODE BEGIN WHILE */
  while (1)
  {
	  /*
	  HAL_ADC_Start(&hadc1);
	  HAL_ADC_PollForConversion(&hadc1, 10);
	  ecg_raw = HAL_ADC_GetValue(&hadc1);
	  printf("ECG raw value: %d\r\n", ecg_raw);
	  float ecg_norm = ecg_raw / 4095.0f;
	  HAL_Delay(1000);
	   */
	  for (int i = 0; i < FFT_SIZE; i++)
	  {
	      inputSignal[i] = round(32767 * sin(2.0 * M_PI * freqBin * i / FFT_SIZE));

	      complexSpectrum[i * 2 + 0] = inputSignal[i];
	      complexSpectrum[i * 2 + 1] = 0;  // keep it zero for now
	  }

	  // generate sine for next frequency bin in next iteration
	  freqBin++;
	  if (freqBin >= FFT_SIZE / 2) freqBin = 1;

	  // FFT:
	  arm_cfft_q15(&arm_cfft_sR_q15_len64, &complexSpectrum[0], 0, 1);
	  // Converting complex spectrum to amplitudes
	  arm_cmplx_mag_q15(&complexSpectrum[0], &realSpectrum[0], FFT_SIZE);

    /* USER CODE END WHILE */

  }
}

void SystemClock_Config(void)
{
  RCC_OscInitTypeDef RCC_OscInitStruct = {0};
  RCC_ClkInitTypeDef RCC_ClkInitStruct = {0};

  /** Configure the main internal regulator output voltage
  */
  __HAL_RCC_PWR_CLK_ENABLE();
  __HAL_PWR_VOLTAGESCALING_CONFIG(PWR_REGULATOR_VOLTAGE_SCALE1);

  /** Initializes the RCC Oscillators according to the specified parameters
  * in the RCC_OscInitTypeDef structure.
  */
  RCC_OscInitStruct.OscillatorType = RCC_OSCILLATORTYPE_HSI;
  RCC_OscInitStruct.HSIState = RCC_HSI_ON;
  RCC_OscInitStruct.HSICalibrationValue = RCC_HSICALIBRATION_DEFAULT;
  RCC_OscInitStruct.PLL.PLLState = RCC_PLL_ON;
  RCC_OscInitStruct.PLL.PLLSource = RCC_PLLSOURCE_HSI;
  RCC_OscInitStruct.PLL.PLLM = 8;
  RCC_OscInitStruct.PLL.PLLN = 168;
  RCC_OscInitStruct.PLL.PLLP = RCC_PLLP_DIV2;
  RCC_OscInitStruct.PLL.PLLQ = 4;
  if (HAL_RCC_OscConfig(&RCC_OscInitStruct) != HAL_OK)
  {
    Error_Handler();
  }

  /** Initializes the CPU, AHB and APB buses clocks
  */
  RCC_ClkInitStruct.ClockType = RCC_CLOCKTYPE_HCLK|RCC_CLOCKTYPE_SYSCLK
                              |RCC_CLOCKTYPE_PCLK1|RCC_CLOCKTYPE_PCLK2;
  RCC_ClkInitStruct.SYSCLKSource = RCC_SYSCLKSOURCE_PLLCLK;
  RCC_ClkInitStruct.AHBCLKDivider = RCC_SYSCLK_DIV1;
  RCC_ClkInitStruct.APB1CLKDivider = RCC_HCLK_DIV4;
  RCC_ClkInitStruct.APB2CLKDivider = RCC_HCLK_DIV2;

  if (HAL_RCC_ClockConfig(&RCC_ClkInitStruct, FLASH_LATENCY_5) != HAL_OK)
  {
    Error_Handler();
  }
}

static void MX_ADC1_Init(void)
{

  ADC_ChannelConfTypeDef sConfig = {0};

  /** Configure the global features of the ADC (Clock, Resolution, Data Alignment and number of conversion)
  */
  hadc1.Instance = ADC1;
  hadc1.Init.ClockPrescaler = ADC_CLOCK_SYNC_PCLK_DIV4;
  hadc1.Init.Resolution = ADC_RESOLUTION_12B;
  hadc1.Init.ScanConvMode = DISABLE;
  hadc1.Init.ContinuousConvMode = DISABLE;
  hadc1.Init.DiscontinuousConvMode = DISABLE;
  hadc1.Init.ExternalTrigConvEdge = ADC_EXTERNALTRIGCONVEDGE_NONE;
  hadc1.Init.ExternalTrigConv = ADC_SOFTWARE_START;
  hadc1.Init.DataAlign = ADC_DATAALIGN_RIGHT;
  hadc1.Init.NbrOfConversion = 1;
  hadc1.Init.DMAContinuousRequests = DISABLE;
  hadc1.Init.EOCSelection = ADC_EOC_SINGLE_CONV;
  if (HAL_ADC_Init(&hadc1) != HAL_OK)
  {
    Error_Handler();
  }

  /** Configure for the selected ADC regular channel its corresponding rank in the sequencer and its sample time.
  */
  sConfig.Channel = ADC_CHANNEL_0;
  sConfig.Rank = 1;
  sConfig.SamplingTime = ADC_SAMPLETIME_144CYCLES;
  if (HAL_ADC_ConfigChannel(&hadc1, &sConfig) != HAL_OK)
  {
    Error_Handler();
  }

}

static void MX_GPIO_Init(void)
{

  /* GPIO Ports Clock Enable */
  __HAL_RCC_GPIOA_CLK_ENABLE();

}

/* USER CODE BEGIN 4 */
int _write(int file, char *ptr, int len)
{
	int DataIdx;
	for (DataIdx = 0; DataIdx < len; DataIdx++) {
		ITM_SendChar(*ptr++);
	}
	return len;
}
/* USER CODE END 4 */

void Error_Handler(void)
{
  __disable_irq();
  while (1)
  {
  }
}
